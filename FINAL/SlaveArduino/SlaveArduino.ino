// ============================================================
// Slave Arduino - 全楽器対応
// ============================================================

#include <Wire.h>

#define MY_I2C_ADDRESS    0      // この楽器のI2Cアドレス
#define SERIAL_BAUD       115200
#define BASE_OCTAVE       4      // 楽譜の基準オクターブ（国際式4）
#define INST_ID 3                // ピアノ=1, 木琴＝2, フルート=3, ドラム=4

// ドラム用定数（Drumslave_ver2.inoと同じ値）
#define DRUM_HIHAT       2
#define DRUM_SNARE       1
#define DRUM_VEL_HIHAT   80
#define DRUM_VEL_SNARE   110

// ------------------------------------------------------------
// 楽譜データ（もりのくまさん 中級アレンジ / ト音譜部+ヘ音譜部 / 120bpm基準）
// 音階配列は各要素が3音分(和音用，未使用分は0=休符)の二次元配列。
// ------------------------------------------------------------

const int pitch_to[][3] = {
  {0,0,0}, {0,0,0}, {0,0,0}, {0,0,0}, {0,0,0}, {0,0,0}, {0,0,0}, {0,0,0},
  {0,0,0}, {0,0,0}, {67,64,0}, {0,0,0}, {69,64,0}, {0,0,0}, {71,64,0}, {0,0,0},

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  {0,0,0}, {0,0,0}, {0,0,0}, {0,0,0}, {0,0,0}, {0,0,0}, {0,0,0}, {0,0,0}
};

const int duration_to[] = {
  0, 0, 0, 0, 0, 0, 0, 0,
  0, 0, 250, 0, 250, 0, 250, 0,

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  0, 0, 0, 0, 0, 0, 0, 0, 
};

const int pitch_he[][3] = {
  {36,0,0}, {0,0,0}, {55,52,0}, {0,0,0}, {36,0,0}, {0,0,0}, {55,52,0}, {0,0,0}, 
  {36,0,0}, {0,0,0}, {55,52,0}, {0,0,0}, {36,0,0}, {0,0,0}, {55,52,0}, {0,0,0}, 

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  {72,0,0}, {0,0,0}, {0,0,0}, {0,0,0}, {48,0,0}, {0,0,0}, {0,0,0}, {0,0,0}
};

const int duration_he[] = {
  250, 0, 250, 0, 250, 0, 250, 0, 
  250, 0, 250, 0, 250, 0, 250, 0,

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  250, 0, 0, 0, 500, 0, 0, 0, 
};


const int SCORE_LENGTH = sizeof(pitch_to) / sizeof(pitch_to[0]);

// ------------------------------------------------------------
// グローバル変数
// ------------------------------------------------------------
volatile bool dataReceived = false;
volatile char rxBuffer[16];      // 割り込み内で受信データを保持するバッファ
volatile int  rxLength    = 0;

int receivedOctave  = 5;      // 受信したオクターブ値
int myPlayOrder     = 1;      // 自分の演奏順（初期設定データ受信で上書きされる）
int currentBPM      = 120;    // 現在のBPM
int startTick       = 0;      // 演奏を開始するTickの閾値
int indexOffset      = -1;    // (i2cReceiveCount - startTick) からindexへの補正値
int i2cReceiveCount = 0;      // I2Cでデータを受信した回数
bool isPlaying      = false;
bool drumNextIsHihat = true;  // ドラム(INST_ID==4)用：次に鳴らす音がハイハットかどうか

void setup() {
  Serial.begin(SERIAL_BAUD);
  Wire.begin(MY_I2C_ADDRESS);
  Wire.onReceive(receiveEvent);
  if(INST_ID == 1) {
    Serial.println("Slave(Piano) Ready.");
  } else if (INST_ID == 2) {
    Serial.println("Slave(Mokkin) Ready.");
  } else if (INST_ID == 3) {
    Serial.println("Slave(Flute) Ready.");
  } else if(INST_ID == 4){
    Serial.println("Slave(Drum) Ready.");
  }else{
    Serial.println("Warning! Invalid instrument!");
  }
}

void loop() {
  if (dataReceived) {
    // 割り込みバッファの内容を，通常の String 変数にコピーして退避
    String input = "";
    for (int i = 0; i < rxLength; i++) {
      input += (char)rxBuffer[i];
    }
    dataReceived = false;
    input.trim();

    // 【デバッグ出力】I2Cで受信した生の文字列と文字数をシリアルモニタに表示
    Serial.print("I2C: ");
    Serial.println(input);

    // ドラム(INST_ID==4)は通常楽器と処理が完全に異なるため，専用関数に分岐する
    if (INST_ID == 4) {
      handleDrum(input);
      return;
    }

    // ========================================================================
    // 【判定1】初期設定データ（8桁）の受信
    // ========================================================================
    if (input.length() == 8) {
      receivedOctave = input.substring(0, 2).toInt();

      // パケット内の演奏順フィールド（index 2,3,4）は，MasterProcessing側が
      // INST_IDの番号（ピアノ=1,木琴=2,フルート=3）と同じ並びで送信するため，
      // index = INST_ID+1 で求まる。
      int orderFieldIndex = (INST_ID >= 1 && INST_ID <= 3) ? INST_ID + 1 : -1; // ドラム(4)等は未使用

      myPlayOrder = (orderFieldIndex >= 0)
        ? input.substring(orderFieldIndex, orderFieldIndex + 1).toInt()
        : 0;
      currentBPM = input.substring(5, 8).toInt();

      if (myPlayOrder == 1) {
        startTick = 0;
        indexOffset = -1;
      } else if (myPlayOrder == 2 || myPlayOrder == 3) {
        startTick = 81;
        indexOffset = 72;  // i2cReceiveCount==83(初回)で75要素目(index75)から始まる
      } else {
        startTick = -1;
        indexOffset = 0;
      }

      i2cReceiveCount = 0;
      isPlaying = (startTick != -1);

      // 【デバッグ出力】解析した設定内容を表示
      Serial.print("  -> Config parsed. Octave:");
      Serial.print(receivedOctave);
      Serial.print(", Order:");
      Serial.print(myPlayOrder);
      Serial.print(", BPM:");
      Serial.print(currentBPM);
      Serial.print(", StartTickLimit:");
      Serial.println(startTick);
    }

    // ========================================================================
    // 【判定2】演奏中のBPMデータ（3桁）の受信 ＝ Tickカウント
    // ========================================================================
    else if (input.length() == 3) {
      currentBPM = input.toInt();

      if (isPlaying) {
        i2cReceiveCount++;

        if (i2cReceiveCount > startTick) {
          int index = (i2cReceiveCount - startTick) + indexOffset;

          // myPlayOrderが2,3のときはTickCount=139（myPlayOrder==1が138要素目を演奏する
          // タイミング）から，myPlayOrder==1と同じ進行に合流する
          if ((myPlayOrder == 2 || myPlayOrder == 3) && i2cReceiveCount >= 139) {
            index = i2cReceiveCount - 1;
          }

          if (index < SCORE_LENGTH) {
            // ① pitchのオクターブ変更処理（主旋律・対旋律それぞれ，3音分）
            int targetOctave = receivedOctave - 1;

            int shiftedTo[3];
            int shiftedHe[3];
            for (int v = 0; v < 3; v++) {
              shiftedTo[v] = 0;
              if (pitch_to[index][v] > 0) {
                shiftedTo[v] = constrain(pitch_to[index][v] + (targetOctave - BASE_OCTAVE) * 12, 0, 127);
              }
              shiftedHe[v] = 0;
              if (pitch_he[index][v] > 0) {
                shiftedHe[v] = constrain(pitch_he[index][v] + (targetOctave - BASE_OCTAVE) * 12, 0, 127);
              }
            }

            // ② durationのBPM補正処理
            long targetDurationTo = (long)duration_to[index] * 120 / currentBPM;
            long targetDurationHe = (long)duration_he[index] * 120 / currentBPM;

            // ③ カンマ区切りでシリアルへ送信（ト音譜部・ヘ音譜部を別の行で送信）
            Serial.print(shiftedTo[0]);
            Serial.print(",");
            Serial.print(shiftedTo[1]);
            Serial.print(",");
            Serial.print(shiftedTo[2]);
            Serial.print(",");
            Serial.println(targetDurationTo);

            Serial.print(shiftedHe[0]);
            Serial.print(",");
            Serial.print(shiftedHe[1]);
            Serial.print(",");
            Serial.print(shiftedHe[2]);
            Serial.print(",");
            Serial.println(targetDurationHe);

            if (index == SCORE_LENGTH - 1) {
              isPlaying = false;
              // 【デバッグ出力】楽譜の最後まで演奏したことを通知
              Serial.println("  -> Score Finished.");
            }
          }
        }
      }
    }
  }
}

// ------------------------------------------------------------
// ドラム専用処理（INST_ID==4 のときだけ呼び出される）
// 出力フォーマットはDrumslave_ver2.inoと同じ "drumType,velocity,BPM"
// ------------------------------------------------------------
void handleDrum(String input) {
  // 【判定1】初期設定データ（8桁）の受信 → 演奏開始
  if (input.length() == 8) {
    i2cReceiveCount = 0;
    isPlaying = true;
    drumNextIsHihat = true;
  }

  // 【判定2】演奏中のBPMデータ（3桁）の受信 ＝ Tickカウント
  else if (input.length() == 3) {
    if (isPlaying) {
      i2cReceiveCount++;
      int tickCount = i2cReceiveCount - 1; // TickCountは0始まり

      // TickCountが4の倍数のときだけ，ハイハットとスネアを交互に発音する
      if (tickCount % 4 == 0) {
        int drumType = drumNextIsHihat ? DRUM_HIHAT : DRUM_SNARE;
        int velocity = drumNextIsHihat ? DRUM_VEL_HIHAT : DRUM_VEL_SNARE;

        Serial.print(drumType);
        Serial.print(",");
        Serial.print(velocity);
        Serial.print(",");
        Serial.println(input);

        drumNextIsHihat = !drumNextIsHihat;
      }

      // TickCountが207（i2cReceiveCountが208）になったら終了
      if (tickCount == 207) {
        isPlaying = false;
      }
    }
  }
}

// ------------------------------------------------------------
// I2C受信割り込みイベント
// ------------------------------------------------------------
void receiveEvent(int numBytes) {
  rxLength = 0;
  while (Wire.available() && rxLength < (int)sizeof(rxBuffer) - 1) {
    rxBuffer[rxLength] = Wire.read();
    rxLength++;
  }
  dataReceived = true;
}
